## Kconfig
```kconfig
#
# For a description of the syntax of this configuration file,
# see the file kconfig-language.txt in the NuttX tools repository.
#

menuconfig LIBBL602_ADC
	bool "BL602 ADC Library"
	default n
	---help---
		Enable build for BL602 ADC Library

if LIBBL602_ADC

config LIBBL602_ADC_DEBUG
	bool "BL602 ADC debugging"
	default n
	---help---
		Enable debugging for BL602 ADC Library

endif # LIBBL602_ADC
```
